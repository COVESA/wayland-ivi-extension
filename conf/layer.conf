## conf/layer.conf
```bitbake
BBPATH .= ":${LAYERDIR}"
BBFILES += "${LAYERDIR}/recipes/*/*.bb \
            ${LAYERDIR}/recipes/*/*.bbappend \
"

BBFILE_COLLECTIONS += "adit-wayland-extensions"
BBFILE_PRIORITY_adit-wayland-extensions = "200"
BBFILE_PATTERN_adit-wayland-extensions = "^${LAYERDIR}/"
```
